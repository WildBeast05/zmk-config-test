## boards/shields/test2/Kconfig.defconfig
```kconfig
if SHIELD_TEST2_LEFT

config ZMK_KEYBOARD_NAME
    default "Test"

config ZMK_SPLIT_ROLE_CENTRAL
    default y

endif

if SHIELD_TEST2_LEFT || SHIELD_TEST2_RIGHT

config ZMK_SPLIT
    default y

endif
```

## boards/shields/test2/Kconfig.shield
```kconfig
config SHIELD_TEST_LEFT
    def_bool $(shields_list_contains,test2_left)

config SHIELD_TEST2_RIGHT
    def_bool $(shields_list_contains,test2_right)
```

## config/boards/shields/test/Kconfig.defconfig
```kconfig
if SHIELD_TEST_LEFT

# Name must be less than 16 characters long!
config ZMK_KEYBOARD_NAME
    default "ShadeBloom"

config ZMK_SPLIT_ROLE_CENTRAL
    default y

endif

if SHIELD_TEST_LEFT

config ZMK_SPLIT
    default y

endif
```
