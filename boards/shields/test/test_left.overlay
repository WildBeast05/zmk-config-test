#include "test.dtsi"

kscan0: kscan {
    compatible = "zmk,kscan-gpio-matrix";
    wakeup-source;
    diode-direction = "row2col";

    row-gpios = 
                <&gpio0 9 GPIO_ACTIVE_HIGH>;
        
    col-gpios = 
                <&gpio0 10 (GPIO_ACTIVE_HIGH | GPIO_PULL_DOWN)>,
                <&gpio1 11 (GPIO_ACTIVE_HIGH | GPIO_PULL_DOWN)>;
        
};